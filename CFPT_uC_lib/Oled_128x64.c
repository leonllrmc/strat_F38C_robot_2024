/*===========================================================================*=
   CFPT - Projet : Oled_128x64.c
   Auteur        : CFPTELEC
   Date creation : 27.01.2021
  =============================================================================
   Descriptif: Fonctions pour communiquer avec un afficheur OLED 128X64.
   
   Datasheet: https://cdn-shop.adafruit.com/datasheets/SSD1306.pdf
   
   Les fonctions pour le capteur (voir descriptif dans les entetes des fonctions)
      void OLEDSendMessageINT(char jsonName[], int dataToSend, unsigned char lin, unsigned char col);
      void OLEDSendMessage(char strToSend[],unsigned char lin, unsigned char col);
      bit InitLCD(unsigned char no_port);
      void AfficherCaractere (char caractere);
      void SelectPosCaractLiCo(unsigned char ligne, unsigned char colonne);
      void AfficherChaineAZT(char str[]);
      void EffacerEcran ();
   
   Les fonctions d'abstraction utilisées pour communiquer sur le bus I2C sont:
      unsigned char I2CWrite   (unsigned char bus, unsigned char addr, unsigned char *buffer, unsigned char buffersize);
      unsigned char I2CRegWrite(unsigned char bus, unsigned char addr, unsigned char reg    , unsigned char dataVal);
      unsigned char I2CRead    (unsigned char bus, unsigned char addr, unsigned char *buffer, unsigned char buffersize);
      unsigned char I2CRegRead (unsigned char bus, unsigned char addr, unsigned char reg    , char *error); 

=*===========================================================================*/
#include "SMBUS.h"
#include "Oled_128x64.h"
#include <stdio.h>


code unsigned char Oled_BasicFont[96][8] = {
  {0x00,0x00,0x00,0x00,0x00,0x00,0x00,0x00},
  {0x00,0x00,0x5F,0x00,0x00,0x00,0x00,0x00},
  {0x00,0x00,0x07,0x00,0x07,0x00,0x00,0x00},
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  {0x00,0x02,0x05,0x05,0x02,0x00,0x00,0x00}
};


code unsigned char Oled_BasicFont1[256][6]={  
{0xBB,0x7F,0x6F,0x7F,0xBB,0xFF},        // caractère 0 (0x00)    
{0xBB,0x7F,0x6F,0x7F,0xBB,0xFF},      
{0xBB,0x7F,0x6F,0x7F,0xBB,0xFF},      
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{0xFF,0xFF,0xFF,0xFF,0xFF,0xFF}};      // caractère 255  



/*---------------------------------------------------------------------------*-
   OLEDSendMessageINT ()
  -----------------------------------------------------------------------------
   Descriptif: Affiche sur l'écran OLED 
   Entrée    : --
   Sortie    : --
-*---------------------------------------------------------------------------*/
void OLEDSendMessageINT(char jsonName[], int dataToSend, unsigned char lin, unsigned char col){
   xdata unsigned char stringTmp[20];
   sprintf(stringTmp,"%s : %6d",jsonName,dataToSend);
   SelectPosCaractLiCo(lin,col);
   AfficherChaineAZT(stringTmp);
}

/*---------------------------------------------------------------------------*-
   OLEDSendMessage ()
  -----------------------------------------------------------------------------
   Descriptif: Affiche sur l'écran OLED 
   Entrée    : --
   Sortie    : --
-*---------------------------------------------------------------------------*/
void OLEDSendMessage(char strToSend[], unsigned char lin, unsigned char col){
   SelectPosCaractLiCo(lin,col);
   AfficherChaineAZT(strToSend);
}




/*---------------------------------------------------------------------------*-
   InitLCD
  -----------------------------------------------------------------------------
   Descriptif: Initialise le Display LCD 4 bits et le port de connexion.
               Caractéristique par défaut: 2 lignes carct. 5x7 dots
   Entrée    : no_port, Numéro du port utilisé par le LCD 4 bits (0, 1 ou 2)
   Sortie    : Error, 0 0k, 1 error
-*---------------------------------------------------------------------------*/
bit InitLCD(unsigned char no_port){
   idata unsigned char buf[2];
   idata unsigned char bus=no_port;
   no_port = no_port; // Evite Warning
   buf[0] = 0x00;
   buf[1] = OLED128X64_DISPLAY_ON_CMD;
   if (I2CWrite(bus,OLED128X64_ADDRESS, buf, 2) == -1)
      return -1;
   #if 0
      buf[0] = 0x00;
      buf[1] = OLED128X64_DISPLAY_ALL_ON_CMD;
      if (I2CWrite(bus,OLED128X64_ADDRESS, buf, 2) == -1)
         return -1;
   #endif
   
   return 1;
}

//
///*---------------------------------------------------------------------------*-
//   AfficherCaract ()
//  -----------------------------------------------------------------------------
//   Descriptif: Affiche un caractère à la position courante du curseur
//   Entrée    : Code Ascii du caractère à afficher
//   Sortie    : --
//-*---------------------------------------------------------------------------*/
void AfficherCaractere (char caractere){
   idata unsigned char buf[2];
   idata unsigned char bus=0;
   idata unsigned char i =0;
   
   #if(0)
      if((caractere < 32) ||(caractere >127)){
         caractere = '?'+32;
      }
      for(i=0;i<8;i++){
         buf[0] = OLED128X64_DATA_MODE;
         buf[1] = Oled_BasicFont[caractere-32][i];
         if (I2CWrite(bus,OLED128X64_ADDRESS, buf, 2) == -1)
            i=8; // il faudrait traiter le cas ou il y a un probleme
      }
   
   #else
      for(i=0;i<6;i++){
         buf[0] = OLED128X64_DATA_MODE;
         buf[1] = ~Oled_BasicFont1[caractere][i];
         if (I2CWrite(bus,OLED128X64_ADDRESS, buf, 2) == -1)
            i=8; // il faudrait traiter le cas ou il y a un probleme
      }
      
   #endif  
}









///*---------------------------------------------------------------------------*-
//   SelectPosCaractLiCo ()
//  -----------------------------------------------------------------------------
//   Descriptif: Sélectionne la position du caractère passé en argument
//   Entrée    : ligne, numéro de la ligne d'affichage 0 ou 1
//               colonne, numéro de la colonne d'affichage 0 à 15
//   Sortie    : --
//-*---------------------------------------------------------------------------*/
void SelectPosCaractLiCo(unsigned char ligne, unsigned char colonne){
   idata unsigned char buf[2];
   idata unsigned char bus=0;
   idata unsigned char charWidth = 6; //8
   //command,  set page address, set column lower address, set column higher address
   
   buf[0] = 0x00;
   buf[1] = 0xB0 + ligne;
   if (I2CWrite(bus,OLED128X64_ADDRESS, buf, 2) == -1)
      bus=0; // Cette fonction retourne -1 en cas d'erreur, mais la fonction EffacerEcran ne gere pas encore cela

   buf[0] = 0x00;
   buf[1] = 0x00 + ((charWidth*colonne+2) & 0x0F);
   if (I2CWrite(bus,OLED128X64_ADDRESS, buf, 2) == -1)
      bus=0; // Cette fonction retourne -1 en cas d'erreur, mais la fonction EffacerEcran ne gere pas encore cela

   buf[0] = 0x00;
   buf[1] = 0x10 + (((charWidth*colonne+2)>>4) & 0x0F);
   if (I2CWrite(bus,OLED128X64_ADDRESS, buf, 2) == -1)
      bus=0; // Cette fonction retourne -1 en cas d'erreur, mais la fonction EffacerEcran ne gere pas encore cela
}

///*---------------------------------------------------------------------------*-
//   AfficherChaineAZT ()
//  -----------------------------------------------------------------------------
//   Descriptif: Affiche une chaîne de caractère AZT à la position courante du 
//               curseur
//   Entrée    : str, de caractères AZT
//   Sortie    : --
//-*---------------------------------------------------------------------------*/
void AfficherChaineAZT(char str[]){
   idata unsigned char i=0;
   while(str[i] != 0){
      AfficherCaractere(str[i]);
      i++;
   }


}
   
//
///*---------------------------------------------------------------------------*-
//   AfficherChaineAZTCentreLi ()
//  -----------------------------------------------------------------------------
//   Descriptif: Affiche une chaîne de caractère AZT Centrer sur la ligne
//   Entrée    : str, chaine de caractères AZT
//               ligne, numéro de la ligne 0 ou 1
//   Sortie    : --
//-*---------------------------------------------------------------------------*/
//extern void AfficherChaineAZTCentreLi(char str[], unsigned char ligne);
//



///*---------------------------------------------------------------------------*-
//   EffacerEcran ()
//  -----------------------------------------------------------------------------
//   Descriptif: Efface l'écran LCD
//   Entrée    : --
//   Sortie    : --
//-*---------------------------------------------------------------------------*/
void EffacerEcran (){
   idata unsigned char buf[2];
   idata unsigned char bus=0;
   idata x,y;
   
   buf[0] = 0x00;
   buf[1] = OLED128X64_DISPLAY_OFF_CMD;
   if (I2CWrite(bus,OLED128X64_ADDRESS, buf, 2) == -1)
      bus=0; // Cette fonction retourne -1 en cas d'erreur, mais la fonction EffacerEcran ne gere pas encore cela

   for(y=0;y<8;y++){
      SelectPosCaractLiCo(y,0);
      //for(x=0;x<16;x++){
      for(x=0;x<22;x++){
         AfficherCaractere(' ');
      }
   }
   buf[0] = 0x00;
   buf[1] = OLED128X64_DISPLAY_ON_CMD;
   if (I2CWrite(bus,OLED128X64_ADDRESS, buf, 2) == -1)
      bus=0; // Cette fonction retourne -1 en cas d'erreur, mais la fonction EffacerEcran ne gere pas encore cela

}
